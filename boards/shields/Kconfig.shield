## boards/shields/Kconfig.shield
```kconfig
config SHIELD_FLOW_LEFT
    def_bool $(shields_list_contains,flow_left)

config SHIELD_FLOW_RIGHT
    def_bool $(shields_list_contains,flow_right)
```

## boards/shields/flow/Kconfig.defconfig
```kconfig
if SHIELD_FLOW_LEFT

# Name must be less than 16 characters long!
config ZMK_KEYBOARD_NAME
    default "flow"

config ZMK_SPLIT_ROLE_CENTRAL
    default y

endif

if SHIELD_FLOW_LEFT || SHIELD_FLOW_RIGHT

config ZMK_SPLIT
    default y

endif
```
