/ {
    kbd {
        compatible = "zmk,keyboard";

        input-gpios = < &gpio0 3 (GPIO_PULL_UP | GPIO_ACTIVE_LOW) >,
                       < &gpio0 4 (GPIO_PULL_UP | GPIO_ACTIVE_LOW) >,
                       < &gpio0 5 (GPIO_PULL_UP | GPIO_ACTIVE_LOW) >,
                       < &gpio1 0 (GPIO_PULL_UP | GPIO_ACTIVE_LOW) >,
                       < &gpio1 1 (GPIO_PULL_UP | GPIO_ACTIVE_LOW) >,
                       < &gpio1 2 (GPIO_PULL_UP | GPIO_ACTIVE_LOW) >;
    };
};
